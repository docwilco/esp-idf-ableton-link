## sdkconfig.defaults.documentation
```kconfig
# This file is only here to make `cargo doc` work properly with ESP-IDF. Any
# project using this crate should set these options in their own
# `sdkconfig.defaults` file.

# Rust often needs a bit of an extra main task stack size compared to C (the default is 3K)
CONFIG_ESP_MAIN_TASK_STACK_SIZE=8000

# Enable C++ exceptions - required for Ableton Link
CONFIG_COMPILER_CXX_EXCEPTIONS=y
```
